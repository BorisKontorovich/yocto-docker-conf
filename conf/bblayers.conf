## conf/bblayers.conf
```bitbake
# BK

# POKY_BBLAYERS_CONF_VERSION is increased each time build/conf/bblayers.conf
# changes incompatibly

POKY_BBLAYERS_CONF_VERSION = "2"

BBPATH = "${TOPDIR}"
BBFILES ?= ""

# These paths are container paths, not host patsh.
BBLAYERS ?= " \
  /home/dev/yocto/source/poky/meta \
  /home/dev/yocto/source/poky/meta-poky \
  /home/dev/yocto/source/poky/meta-yocto-bsp \
  "
```
